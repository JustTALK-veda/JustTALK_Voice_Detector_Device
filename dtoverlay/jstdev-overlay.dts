/dts-v1/;
/plugin/;

&{/soc/spi@7e204000} {
    status = "okay";
};

&{/soc/spi@7e204000/spidev@0} {
    status = "disabled";
};

&{/soc/spi@7e204000} {
    jstdev@0 {
        compatible = "jstdev";
        reg = <0x0>;
        spi-max-frequency = <10000000>;
        status = "okay";
    };
};